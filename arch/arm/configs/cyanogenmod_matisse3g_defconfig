## arch/arm/configs/cyanogenmod_matisse3g_defconfig
```kconfig
CONFIG_ARCH_MSM8226_3G_WIFI

CONFIG_MACH_MATISSE3G_OPEN=y

CONFIG_CONFIG_HAPTIC_ISA1200=y

CONFIG_SENSORS_SX9500=y
CONFIG_SENSORS_SX9500_INIT_TOUCH_THRESHOLD=3000
CONFIG_SENSORS_SX9500_NORMAL_TOUCH_THRESHOLD=15
CONFIG_SENSORS_GRIP_ADJDET=y
```

## arch/arm/configs/cyanogenmod_matisselte_defconfig
```kconfig
CONFIG_ARCH_MSM8926_LTE=y

CONFIG_SEC_MATISSELTE_COMMON=y
CONFIG_MACH_MATISSELTE_OPEN=y

CONFIG_CONFIG_HAPTIC_ISA1200=y
CONFIG_VIBRATOR_UPDATE=y

CONFIG_SENSORS_SX9500=y
CONFIG_SENSORS_SX9500_INIT_TOUCH_THRESHOLD=3000
CONFIG_SENSORS_SX9500_NORMAL_TOUCH_THRESHOLD=15
CONFIG_SENSORS_GRIP_ADJDET=y
```

## arch/arm/configs/cyanogenmod_matissewifi_defconfig
```kconfig
CONFIG_ARCH_MSM8226_3G_WIFI

CONFIG_SEC_MATISSEWIFI_COMMON=y
CONFIG_MACH_MATISSEWIFI_OPEN=y

CONFIG_IR_REMOCON_MC96FR116=y
```

## arch/arm/configs/cyanogenmod_millet3g_defconfig
```kconfig
CONFIG_MACH_MILLET3G_EUR=y
CONFIG_SEC_MILLET_PROJECT=y

CONFIG_FB_MSM_MDSS_SDC_WXGA_PANEL=y
CONFIG_ESD_ERR_FG_RECOVERY=y
CONFIG_TOUCHSCREEN_MMS252=y

CONFIG_INPUT_POLLDEV=y

CONFIG_SND_SOC_MAX98504=y

CONFIG_ARCH_MSM8226_3G_WIFI

CONFIG_DIRECT_RECLAIM_FILE_PAGES_ONLY=n

CONFIG_IR_REMOCON_MC96FR116=y
```

## arch/arm/configs/cyanogenmod_milletlte_defconfig
```kconfig
CONFIG_MACH_MILLETLTE_OPEN=y
CONFIG_SEC_MILLET_PROJECT=y
CONFIG_SEC_MILLETLTE_COMMON=y

CONFIG_FB_MSM_MDSS_SDC_WXGA_PANEL=y
CONFIG_ESD_ERR_FG_RECOVERY=y
CONFIG_TOUCHSCREEN_MMS252=y

CONFIG_INPUT_POLLDEV=y

CONFIG_SND_SOC_MAX98504=y

CONFIG_ARCH_MSM8926_LTE=y

CONFIG_DIRECT_RECLAIM_FILE_PAGES_ONLY=n

CONFIG_HID_ZAGG=y
```
